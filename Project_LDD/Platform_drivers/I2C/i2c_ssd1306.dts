/ {
    ssd1306@0 {
        compatible = "my_platform,ssd1306";
        i2c-bus = <1>;          /* I2C bus number */
        i2c-addr = <0x3C>;      /* OLED address */
        status = "okay";
    };
};

