/dts-v1/;
/plugin/;

/ {
    compatible = "brcm,bcm2771";

    fragment@0 {
        target = <&spi0>;
        __overlay__ {
            #address-cells = <1>;
            #size-cells = <0>;

            ili9225@0 {
                compatible = "ilitek,ili9225";
                reg = <0>;                  // SPI chip-select 0
                spi-max-frequency = <32000000>;
                dc-gpios = <&gpio 24 0>;    // Data/Command pin
                reset-gpios = <&gpio 25 0>; // Reset pin
                status = "okay";
            };
        };
    };
};

