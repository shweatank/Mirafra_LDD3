/dts-v1/;
/plugin/;

/ {
    compatible = "brcm,bcm2711";

    fragment@0 {
        target = <&uart1>;   // Use PL011 UART1
        __overlay__ {
            status = "okay";
            pinctrl-names = "default";
            pinctrl-0 = <&uart1_pins>;
        };
    };

    fragment@1 {
        target = <&gpio>;
        __overlay__ {
            uart1_pins: uart1_pins {
                brcm,pins = <14 15>;    // GPIO14 = TXD1, GPIO15 = RXD1
                brcm,function = <2>;    // ALT5 for UART1
            };
        };
    };
};

