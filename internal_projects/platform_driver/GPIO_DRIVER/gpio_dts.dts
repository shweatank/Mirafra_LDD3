/dts-v1/;
/plugin/;

/ {
    compatible = "brcm,bcm2711";

    fragment@0 {
        target-path = "/";
        __overlay__ {
            gpio_led: gpio_led{
                compatible = "custom,led";
                led-gpios = <&gpio 18 0>; // GPIO17, active high
                label = "LED";
                status = "okay";
            };
        };
    };
};
