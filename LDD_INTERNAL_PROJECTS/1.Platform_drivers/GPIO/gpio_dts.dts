/dts-v1/;
/plugin/;

/ {
    compatible = "brcm,bcm2835";

    fragment@0 {
        target-path = "/";
        __overlay__ {
            gpio_led_blink: led_blink@0 {
                compatible = "blinky,gpio-led";
                status = "okay";
                gpios = <&gpio 17 0>; // GPIO17, active-high
                gpio-names = "led";
            };
        };
    };
};
