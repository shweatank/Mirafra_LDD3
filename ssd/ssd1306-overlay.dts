/* ------------------------------
* ssd1306-overlay.dts (Raspberry Pi Device Tree Overlay)
* ------------------------------
*/
/dts-v1/;
/plugin/;


/ {
compatible = "brcm,bcm2835";


fragment@0 {
target = <&i2c1>;
__overlay__ {
#address-cells = <1>;
#size-cells = <0>;
status = "okay";


oled@3c {
compatible = "pavan,ssd1306-fb"; /* bind to our driver only */
reg = <0x3c>; /* 0x3C or 0x3D */
};
};
};
};
